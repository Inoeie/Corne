## config/boards/arm/Kconfig.board
```kconfig
# BT60 board configuration

# Copyright (c) 2021 Polarity Works
# SPDX-License-Identifier: MIT

config BOARD_Nice_Nano
	bool "Nice!Nano"
	depends on SOC_NRF52840_QIAA
```
